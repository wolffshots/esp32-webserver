## Kconfig.projbuild
```kconfig
# config vars for esp32-webserver
menu "wolffshots/esp32-webserver config"
    config WEBSERVER_LOG_TAG
        string "webserver tag"
        default "esp32-webserver"
        help
            tag for use with esp log library for webserver library
endmenu
```
